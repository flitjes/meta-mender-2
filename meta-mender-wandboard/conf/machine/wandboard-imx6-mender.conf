## meta-mender-wandboard/conf/machine/wandboard-imx6-mender.conf
```bitbake
require conf/machine/wandboard.conf

MACHINEOVERRIDES =. "wandboard:"

MENDER_STORAGE_TOTAL_SIZE_MB = "8000"
MENDER_UBOOT_STORAGE_DEVICE = "0"
MENDER_STORAGE_DEVICE = "/dev/mmcblk2"

BOOTENV_SIZE = "0x20000"

IMAGE_BOOTLOADER_FILE = "${MENDER_BOOTLOADER_BLOB}"
IMAGE_BOOTLOADER_BOOTSECTOR_OFFSET = "2"
```
